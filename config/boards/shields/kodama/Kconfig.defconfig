## config/boards/shields/kodama/Kconfig.defconfig
```kconfig
if SHIELD_KODAMA_LEFT

config ZMK_KEYBOARD_NAME
    default "kodama"

config ZMK_SPLIT_ROLE_CENTRAL
    default y

endif

if SHIELD_KODAMA_LEFT || SHIELD_KODAMA_RIGHT

config ZMK_SPLIT
    default y

endif
```

## config/boards/shields/kodama/Kconfig.shield
```kconfig
config SHIELD_KODAMA_LEFT
  def_bool $(shields_list_contains, kodama_left)

config SHIELD_KODAMA_RIGHT
  def_bool $(shields_list_contains, kodama_right)
```
